## conf/layer.conf
```bitbake
BBPATH .= ":${LAYERDIR}"
BBFILES += "${LAYERDIR}/recipes-*/*/*.bb \
            ${LAYERDIR}/recipes-*/*/*.bbappend"
BBFILE_COLLECTIONS += "sdbus-lite"
BBFILE_PATTERN_sdbus-lite = "^${LAYERDIR}/"
BBFILE_PRIORITY_sdbus-lite = "6"
LAYERDEPENDS_sdbus-lite = "core"
LAYERSERIES_COMPAT_sdbus-lite = "scarthgap"
```
